## conf/distro/BeeOS.conf
```bitbake
require conf/disto/poky.conf

DISTRO = "BeeOS"
DISTRO_NAME =  "OS for Odroid"
AUTHOR = "michael BARBARIN <michael.barbarin@protonmail.com>"
RECIPE_MAINTAINER = "michael BARBARIN <michael.barbarin@protonmail.com>"
LICENCE = "MIT"
```

## conf/layer.conf
```bitbake
# We have a conf and classes directory, add to BBPATH
BBPATH .= ":${LAYERDIR}"

# We have a packages directory, add to BBFILES
BBFILES += "${LAYERDIR}/recipes-*/*/*.bb ${LAYERDIR}/recipes-*/*/*.bbappend"

BBFILE_COLLECTIONS += "uavia-layer"
BBFILE_PATTERN_uavia-layer := "^${LAYERDIR}/"
BBFILE_PRIORITY_uavia-layer = "14"

# Do not error out on bbappends for missing recipes.
BB_DANGLINGAPPENDS_WARNONLY = "true"
```
